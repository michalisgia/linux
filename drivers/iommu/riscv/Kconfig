## drivers/iommu/riscv/Kconfig
```kconfig
# SPDX-License-Identifier: GPL-2.0-only
# RISC-V IOMMU support

config RISCV_IOMMU
	bool "RISC-V IOMMU driver"
	depends on RISCV
	select IOMMU_API
	select IOMMU_DMA
	select IOMMU_IO_PGTABLE
	select IOMMU_IOVA
	select IOMMU_SVA
	select IOASID
	select PCI_MSI
	select PCI_ATS
	select PCI_PRI
	select PCI_PASID
	select MMU_NOTIFIER
	help
	  This option enables support for the RISC-V IOMMU hardware.
```
